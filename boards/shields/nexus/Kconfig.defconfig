## boards/shields/nexus/Kconfig.defconfig
```kconfig
if SHIELD_NEXUS_LEFT

config ZMK_KEYBOARD_NAME
    default "Nexus"

config ZMK_SPLIT_ROLE_CENTRAL
    default y

endif

if SHIELD_NEXUS_LEFT || SHIELD_NEXUS_RIGHT

config ZMK_SPLIT
    default y

endif
```

## boards/shields/nexus/Kconfig.shield
```kconfig
config SHIELD_NEXUS_LEFT
    def_bool $(shields_list_contains,nexus_left)

config SHIELD_NEXUS_RIGHT
    def_bool $(shields_list_contains,nexus_right)
```
